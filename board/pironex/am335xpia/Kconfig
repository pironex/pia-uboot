## board/pironex/am335xpia/Kconfig
```kconfig
if TARGET_AM335X_PIA

config SYS_BOARD
	default "am335xpia"

config SYS_VENDOR
	default "pironex"

config SYS_SOC
	default "am33xx"

config SYS_CONFIG_NAME
	default "am335x_pia"

config PIA_FIRSTSTART
	bool "Special EEPROM initialization version"
	default n

choice
	prompt "Firstart Target"
	depends on PIA_FIRSTSTART

config PIA_BASE
	bool "piA-AM3352 board with PM module"

config PIA_DR
	bool "piA-AM335x-DR (APC) board with PM module"

config PIA_SK
	bool "piA-AM335x-SK board with PM module"

config PIA_UNKNOWN
	bool "unknown board allows manual specification of EEPROM values"

endchoice

if PIA_FIRSTSTART

config PIA_PM
	bool
	depends on PIA_FIRSTSTART
	default y if (PIA_SK || PIA_BASE || PIA_DR || PIA_EBTFT)


config BOARD_MEMTYPE
	int
	depends on PIA_PM
	range 0 1
	default 0

config BOARD_NAME
	string
	default "PIA335PM" if PIA_PM
	prompt "Board name for I2C0 EEPROM (PM board). Max 8 chars" if PIA_UNKNOWN

config BOARD_REVISION
	string
	default "0.02" if PIA_PM
	prompt "Board rev. for I2C0 EEPROM (PM board). Format: x.yz" if PIA_UNKNOWN

config EXP_NAME
	string
	default "P335BSK" if PIA_SK
	default "P335BDR" if PIA_DR
	default "P335BPIA" if PIA_BASE
	prompt "Board name for I2C1 EEPROM (baseboard). Max 8 chars" if PIA_UNKNOWN
choice
	prompt "Memory Type"
	depends on PIA_PM

config PIA_MEM_256
	bool "Standard 256 MByte memory configuration"

config PIA_MEM_512
	bool "512 MB"

endchoice

config EXP_REVISION
	string
	default "0.02" if PIA_SK
	default "0.03" if PIA_DR
	default "0.01" if PIA_BASE
	prompt "Board rev. for I2C1 EEPROM (baseboard). Format: x.yz" if PIA_UNKNOWN

endif

config NAND
	bool "Support for NAND flash"
	help
	  Some piA boards contain a NAND flash connected to GPMC.
	  This option adds u-boot support to access the NAND.

config NAND_BOOT
	bool "Support for booting from NAND flash"
	depends on NAND
	help
	  Enabling this will make a U-Boot binary that is capable of being
	  booted via NAND.  In this case we will enable certain pinmux early
	  as the ROM only partially sets up pinmux.  We also default to using
	  NAND for environment.

endif
```

## configs/am335x_pia_defconfig
```kconfig
CONFIG_ARM=y
CONFIG_TARGET_AM335X_PIA=y
CONFIG_SPL=y
CONFIG_SPL_STACK_R=y
CONFIG_SPL_STACK_R_ADDR=0x82000000
CONFIG_SYS_EXTRA_OPTIONS=""
# CONFIG_CMD_IMLS is not set
# CONFIG_CMD_FLASH is not set
# CONFIG_CMD_SETEXPR is not set
# this should be moved to a PM specific defconfig
CONFIG_SPI_FLASH=y
CONFIG_AUTOBOOT_KEYED=y
CONFIG_AUTOBOOT_STOP_STR="s"
```
